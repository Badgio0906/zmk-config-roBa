## Kconfig
```kconfig
# Provide a typed definition for LV_DISP_DEF_REFR_PERIOD so that
# prospector-zmk-module's Kconfig.defconfig can safely override its default
# without triggering a "defined without a type" Kconfig warning.
config LV_DISP_DEF_REFR_PERIOD
	int
	default 30
```

## config/boards/shields/Test/Kconfig.shield
```kconfig
config SHIELD_ROBA_R
def_bool $(shields_list_contains,roBa_R)

config SHIELD_ROBA_R_COROPIT
def_bool $(shields_list_contains,roBa_R_coropit)

config SHIELD_ROBA_R_PERIPH
def_bool $(shields_list_contains,roBa_R_periph)

config SHIELD_ROBA_L
def_bool $(shields_list_contains,roBa_L)

config SHIELD_ROBA_DONGLE
def_bool $(shields_list_contains,roBa_dongle)
```

## config/west.yml
```yaml
manifest:
  remotes:
    - name: zmkfirmware
      url-base: https://github.com/zmkfirmware
    # - name: carrefinho
    #   url-base: https://github.com/carrefinho
  projects:
    - name: zmk
      remote: zmkfirmware
      revision: main
      import: app/west.yml
    # prospector-zmk-module は Zephyr 4.1 (ZMK main) 専用。v0.3-branch では除外
    # - name: prospector-zmk-module
    #   remote: carrefinho
    #   revision: feat/new-status-screens
  self:
    path: config
```
